## conf/layer.conf
```bitbake
# We have a conf and classes directory, append to BBPATH
BBPATH .= ":${LAYERDIR}"

# We have a recipes directory, add to BBFILES
BBFILES += "${LAYERDIR}/recipes-*/*/*.bb ${LAYERDIR}/recipes-*/*/*.bbappend \
            ${LAYERDIR}/recipes-*/*/*/*.bb ${LAYERDIR}/recipes-*/*/*/*.bbappend"
            
DISTRO_NAME = "openmb"
DISTRO_HOST = "openmb.net"
DISTRO_FEED_URI ?= "http://${DISTRO_HOST}/feeds/${FEED_NAME}"
BRANDINGDIR := '${@os.path.normpath("${LAYERDIR}/../meta-miraclebox")}'
```

## conf/machine/include/miraclebox.inc
```bitbake
MACHINE_KERNEL_PR = "r0"

KERNEL_MODULE_AUTOLOAD += "xfs"

# We know about rtc
MACHINE_FEATURES_BACKFILL_CONSIDERED = "rtc"

IMAGE_CMD_ubi_prepend = " \
	rm -Rf ${IMAGE_ROOTFS}/tmp/*; \
	"

MACHINE_ESSENTIAL_EXTRA_RDEPENDS = "\
	${@bb.utils.contains("GST_VERSION", "1.0", "gstreamer1.0-libav", "gst-ffmpeg", d)} \
	miraclebox-dvb-modules-${MACHINE} \
	kernel-vmlinux \
	"

MACHINE_ESSENTIAL_EXTRA_RRECOMMENDS = "\
	kernel-module-cdfs \
	"

MACHINE_EXTRA_RRECOMMENDS = " \
	gst-plugin-dvbmediasink \
	${@bb.utils.contains("MACHINE_FEATURES", "extrasplash", "miraclebox-cfe", "", d)} \
	"

DVBMEDIASINK_CONFIG = "--with-wma --with-wmv --with-pcm --with-dts --with-eac3"

TARGET_ARCH = "mipsel"
DEFAULTTUNE ?= "mips32el"

PREFERRED_PROVIDER_virtual/kernel = "linux-${MACHINE}"

PREFERRED_PROVIDER_virtual/blindscan-dvbc = "miraclebox-blindscan-utils-${MACHINE}"
PREFERRED_PROVIDER_virtual/blindscan-dvbs = "miraclebox-blindscan-utils-${MACHINE}"

KERNEL_IMAGETYPE = "vmlinux"
KERNEL_OUTPUT = "${KERNEL_IMAGETYPE}"
KERNEL_OUTPUT_DIR = "."
KERNEL_CONSOLE = "null"
SERIAL_CONSOLE ?= ""

IMAGE_FSTYPES ?= "ubi"

UBI_VOLNAME = "rootfs"

IMGDEPLOYDIR ?= "${DEPLOY_DIR_IMAGE}"
IMAGEVERSION := "${DISTRO_NAME}-${DISTRO_VERSION}-${DATE}"
IMAGEVERSION[vardepsexclude] = "DATE"

IMAGE_CMD_ubi_append = " \
	mkdir -p ${IMGDEPLOYDIR}/${IMAGEDIR}; \
	cp ${IMGDEPLOYDIR}/${IMAGE_NAME}.rootfs.ubi ${IMGDEPLOYDIR}/${IMAGEDIR}/rootfs.bin; \
	gzip -9c ${DEPLOY_DIR_IMAGE}/vmlinux-${MACHINE}.bin > ${IMGDEPLOYDIR}/${IMAGEDIR}/kernel.bin; \
	${@bb.utils.contains("MACHINE_FEATURES", "extrasplash", "cp ${DEPLOY_DIR_IMAGE}/splash.bin ${IMGDEPLOYDIR}/${IMAGEDIR}/;" , "", d)} \
	${@bb.utils.contains("MACHINE_FEATURES", "extrasplash", "cp ${DEPLOY_DIR_IMAGE}/cfe.bmp ${IMGDEPLOYDIR}/${IMAGEDIR}/;" , "", d)} \
	${@bb.utils.contains("MACHINE_FEATURES", "extrasplash", "cp ${DEPLOY_DIR_IMAGE}/splash.bmp ${IMGDEPLOYDIR}/${IMAGEDIR}/;" , "", d)} \
	${@bb.utils.contains("MACHINE_FEATURES", "extrasplash", "cp ${DEPLOY_DIR_IMAGE}/imageversion.bmp ${IMGDEPLOYDIR}/${IMAGEDIR}/;" , "", d)} \
	${@bb.utils.contains("MACHINE_FEATURES", "extrasplash", "cp ${DEPLOY_DIR_IMAGE}/kernel.bmp ${IMGDEPLOYDIR}/${IMAGEDIR}/;" , "", d)} \
	${@bb.utils.contains("MACHINE_FEATURES", "extrasplash", "cp ${DEPLOY_DIR_IMAGE}/rootfs.bmp ${IMGDEPLOYDIR}/${IMAGEDIR}/;" , "", d)} \
	${@bb.utils.contains("MACHINE_FEATURES", "extrasplash", "cp ${DEPLOY_DIR_IMAGE}/finished.bmp ${IMGDEPLOYDIR}/${IMAGEDIR}/;" , "", d)} \
	echo "${IMAGEVERSION}" > ${IMGDEPLOYDIR}/${IMAGEDIR}/imageversion; \
	echo "rename this file to 'force' to force an update without confirmation" > ${IMGDEPLOYDIR}/${IMAGEDIR}/noforce; \
	cd ${IMGDEPLOYDIR}; \
	zip ${DISTRO_NAME}-${DISTRO_VERSION}-${MACHINE}-${DATE}_usb.zip ${IMAGEDIR}/*; \
	rm -Rf ${IMAGEDIR}; \
	"

IMAGE_CMD_ubi_prepend = " \
	rm -Rf ${IMAGE_ROOTFS}/tmp/*; \
	"

MACHINE_FEATURES += "alsa usbhost wlan 3dtv switchoff osdposition hdmicec dvbusb"

require conf/machine/include/tune-mips32.inc
require conf/machine/include/miraclebox-wifi.inc
```

## conf/machine/mbmicro.conf
```bitbake
#@TYPE: Machine
#@NAME: Miraclebox
#@DESCRIPTION: Machine configuration for the Miraclebox Premium Micro

require conf/machine/include/miraclebox.inc

IMAGEDIR ?= "miraclebox/micro"

PREFERRED_VERSION_linux-${MACHINE} = "4.0.1"

MKUBIFS_ARGS = "-m 2048 -e 126976 -c 8192"
UBINIZE_ARGS = "-m 2048 -p 128KiB"

MACHINE_FEATURES += "dvb-c"

CHIPSET = "bcm7362"
```

## conf/machine/mbmini.conf
```bitbake
#@TYPE: Machine
#@NAME: Miraclebox
#@DESCRIPTION: Machine configuration for the Miraclebox Premium Mini

require conf/machine/include/miraclebox.inc

IMAGEDIR ?= "miraclebox/mini"

MACHINE_BRAND = "Miraclebox"
MACHINE_NAME = "Premium Mini"
MACHINEBUILD = "mbmini"
MACHINE_OEM = "inihde"

PREFERRED_VERSION_linux-${MACHINE} = "3.12.1"

MKUBIFS_ARGS = "-m 2048 -e 126976 -c 4096"
UBINIZE_ARGS = "-m 2048 -p 128KiB"

MACHINE_FEATURES += " textlcd ci dvb-c blindscan-dvbc blindscan-dvbs"

CHIPSET = "bcm7358"
#DEFAULTTUNE = "mips32el-nf"
```

## conf/machine/mbminiplus.conf
```bitbake
#@TYPE: Machine
#@NAME: Miraclebox
#@DESCRIPTION: Machine configuration for the Miraclebox Premium Mini Plus

IMAGEDIR ?= "miraclebox/miniplus"

MACHINE_BRAND = "Miraclebox"
MACHINE_NAME = "Premium Mini PLUS"
MACHINEBUILD = "mbminiplus"
MACHINE_OEM = "inihde2"

PREFERRED_PROVIDER_virtual/kernel = "linux-mbminiplus"
PREFERRED_VERSION_linux-${MACHINE} = "3.14.2"

PREFERRED_PROVIDER_virtual/blindscan-dvbc = "miraclebox-blindscan-dvbc-utils"
PREFERRED_PROVIDER_virtual/blindscan-dvbs = "miraclebox-blindscan-dvbs-utils"

MKUBIFS_ARGS = "-m 2048 -e 126976 -c 4096"
UBINIZE_ARGS = "-m 2048 -p 128KiB"

MACHINE_FEATURES += " ci dvb-c blindscan-dvbc blindscan-dvbs extrasplash"

CHIPSET = "bcm7362"

require conf/machine/include/miraclebox.inc
```

## conf/machine/mbtwin.conf
```bitbake
#@TYPE: Machine
#@NAME: Miraclebox
#@DESCRIPTION: Machine configuration for the Miraclebox Premium Twin

require conf/machine/include/miraclebox.inc

IMAGEDIR ?= "miraclebox/twin"

MACHINE_BRAND = "Miraclebox"
MACHINE_NAME = "Premium Twin"
MACHINEBUILD = "mbtwin"
MACHINE_OEM = "inihdx"

PREFERRED_VERSION_linux-${MACHINE} = "3.6.0"

MKUBIFS_ARGS = "-m 2048 -e 126976 -c 4096"
UBINIZE_ARGS = "-m 2048 -p 128KiB"

MACHINE_FEATURES += " textlcd ci dvb-c blindscan-dvbc blindscan-dvbs fan textlcd"

CHIPSET = "bcm7413"

GLIBCVERSION = "2.22"
```

## conf/machine/mbtwinplus.conf
```bitbake
#@TYPE: Machine
#@NAME: Miraclebox
#@DESCRIPTION: Machine configuration for the Miraclebox Premium Twin+

require conf/machine/include/miraclebox.inc

IMAGEDIR ?= "miraclebox/twinplus"

PREFERRED_VERSION_linux-miraclebox = "4.1.15"

PREFERRED_PROVIDER_virtual/blindscan-dvbc = "miraclebox-blindscan-dvbc-utils-${MACHINE}"

MKUBIFS_ARGS = "-m 2048 -e 126976 -c 8192"
UBINIZE_ARGS = "-m 2048 -p 128KiB"

MACHINE_FEATURES += "dvb-c ci textlcd blindscan-dvbc"

CHIPSET = "bcm7241"
FORCE_REBOOT_OPTION = "reboot"

MACHINE_EXTRA_RDEPENDS += "enigma2-plugin-extensions-hbbtv-miraclebox"
```

## conf/machine/mbultra.conf
```bitbake
#@TYPE: Machine
#@NAME: Miraclebox
#@DESCRIPTION: Machine configuration for the Miraclebox Premium Ultra

require conf/machine/include/miraclebox.inc

IMAGEDIR ?= "miraclebox/ultra"

MACHINE_BRAND = "Miraclebox"
MACHINE_NAME = "Premium Ultra"
MACHINEBUILD = "mbultra"
MACHINE_OEM = "inihdp"

PREFERRED_VERSION_linux-${MACHINE} = "3.14.2"

MKUBIFS_ARGS = "-m 4096 -e 1040384 -c 1984"
UBINIZE_ARGS = "-m 4096 -p 1024KiB"

MACHINE_FEATURES += " ci dvb-c blindscan-dvbc blindscan-dvbs colorlcd extrasplash"

CHIPSET = "bcm7425"

MACHINE_EXTRA_RDEPENDS = "\
    \
    miraclebox-coldboot \
    miraclebox-ethwol \
    \
    rt8723bt kernel-module-rtk-btusb \
    rt8723a kernel-module-8723au \
    rt3070 firmware-rt2870 \
    \
    enigma2-plugin-systemplugins-manualfancontrol \
    "
```
